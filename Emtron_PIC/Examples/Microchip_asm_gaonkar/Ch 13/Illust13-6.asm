	Title "PIC18F452 Illust 13-6"
	List p=18F452
	#include <p18F452.inc>	;This is a header file and must be included 
							;in the Source Program
OUTREG		EQU		0x20
INREG		EQU		0x21
ADDR		EQU		0x10
DATA_BYTE	EQU		0x55

RD_CMD		EQU		B'10100000'
WR_CMD		EQU		B'10100001'

			ORG		00
			GOTO 	MAIN

			ORG		0x20
MAIN:		RCALL	SETUP
			RCALL	START_BIT
			RCALL	TX_BYTE
			RCALL	STOP_BIT
WR_FAIL		NOP
HERE		BRA		HERE

SETUP:		MOVLW	B'00011000'
			IORWF	TRISC	
			CLRF	SSPCON2		;Clear SSPCON2 and SSPSTAT
			CLRF	SSPSTAT
			BSF		SSPSTAT, SMP;
			BCF		PIR1, SSPIF
			BCF		PIR2, BCLIF
			MOVLW	B'00011000'	;
			MOVWF	SSPADD
			MOVLW	B'00101000'	;
			MOVWF	SSPCON1
			RETURN

START_BIT:	BCF		PIR1, SSPIF
			BSF		SSPCON2, SEN 
CHK_SEN:	BTFSS	PIR1, SSPIF
			BRA		CHK_SEN
			RETURN

STOP_BIT:	BCF		PIR1, SSPIF
			BSF		SSPCON2, PEN 
CHK_PEN:	BTFSS	PIR1, SSPIF
			BRA		CHK_PEN
			RETURN

WR_BYTE		BCF		PIR1, SSPIF
			MOVF	OUTREG, W
			MOVWF	SSPBUF
CHK_BYTE:	BTFSS	PIR1, SSPIF
			BRA		CHK_BYTE
			BTFSC	SSPCON2,ACKSTAT
			BRA		WR_FAIL
			RETURN

TX_BYTE:	
SEND_CMD	MOVLW	WR_CMD
			MOVWF	OUTREG
			RCALL	WR_BYTE

SEND_ADDR	MOVLW	ADDR
			MOVWF	OUTREG
			RCALL	WR_BYTE

SEND_BYTE	MOVLW	DATA_BYTE
			MOVWF	OUTREG
			RCALL	WR_BYTE
			RETURN

			END
